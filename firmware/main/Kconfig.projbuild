## firmware/main/Kconfig.projbuild
```kconfig
menu "RLight"

    config RLIGHT_WIFI_SSID
        string "Wi-Fi SSID"
        default ""

    config RLIGHT_WIFI_SENHA
        string "Wi-Fi senha"
        default ""

    config RLIGHT_SERVIDOR
        string "WebSocket do voz_server.py (sem o token)"
        default "ws://192.168.1.10:8765/dispositivo"

    config RLIGHT_TOKEN
        string "Token do terminal (RLIGHT_TERMINAL_TOKEN do servidor)"
        default ""

    config RLIGHT_ID
        string "Nome deste terminal (vai no histórico)"
        default "sala"

    config RLIGHT_VOLUME
        int "Volume do alto-falante (%)"
        range 5 100
        default 55

    config RLIGHT_BARGEIN_DBFS
        int "Portão de eco: volume pós-AEC (dBFS) para valer como interrupção enquanto o terminal fala"
        range -60 0
        default -22

    config RLIGHT_EQ
        bool "Equalizar a saída para alto-falante pequeno (corta grave < 150 Hz e um pouco de agudo)"
        default y

    config RLIGHT_MIC_GANHO_BITS
        int "Ganho digital do INMP441 depois do passa-alta (bits; 3 = x8, +18 dB)"
        range 0 8
        default 3

    config RLIGHT_MIC_SLOT_DIREITO
        bool "INMP441 no slot direito (L/R em 3V3)"
        default n

    config RLIGHT_AEC_FD
        bool "AEC full-duplex (FD_LOW_COST: linear + não linear; melhor para interromper)"
        default y
        help
            Desligado = AEC_MODE_SR_HIGH_PERF (só linear, o padrão do AFE de palavra
            de ativação). Use se o FD estragar a sua voz ou a detecção da palavra.

    config RLIGHT_AMP_SD_GPIO
        int "GPIO ligado ao SD do MAX98357A (-1 = SD solto, amp sempre ligado)"
        default 18

    config RLIGHT_ECONOMIA_WIFI
        bool "Wi-Fi em modem sleep enquanto espera a palavra"
        default y

    config RLIGHT_ECONOMIA_CPU
        bool "AEC desligado enquanto espera a palavra"
        default y
        help
            Esperando a palavra nada toca, então o AEC (a parte mais pesada do AFE) fica
            desligado e volta antes do bipe de início.

    config RLIGHT_INA_SHUNT_MOHM
        int "Shunt do INA226 em mΩ (R100 = 100, R010 = 10)"
        default 100

    config RLIGHT_CARGA_GPIO
        int "GPIO ligado ao CE do carregador da UPS (-1 = sem controle de carga)"
        range -1 48
        default -1
        help
            Pino 8 (CE) do 4056 do HW-465A levantado da placa e ligado por fio a este
            GPIO, em open-drain: solto = o pull-up interno do 4056 carrega; em 0 = carga
            parada. Na tomada, a bateria fica entre CARGA_LIGA_MV e CARGA_PARA_MV.

    config RLIGHT_TOMADA_GPIO
        int "GPIO que lê a fonte da UPS (divisor 100k/100k do furo 5V+; -1 = lê pelo CE)"
        range -1 48
        default -1
        help
            Sem ele, a tomada é detectada soltando o CE e lendo o pino, o que só vale com
            o GPIO ligado direto no CE. Com o PNP e o pull-up de 100 kΩ no pino 4, o pino 4
            recebe tensão mesmo sem fonte e o CE sempre lê alto.

    config RLIGHT_CARGA_LIGA_MV
        int "Na tomada: libera a carga com a bateria em repouso abaixo de (mV)"
        default 3750

    config RLIGHT_CARGA_PARA_MV
        int "Na tomada: para a carga quando a tensão carregando chegar a (mV)"
        default 3950
        help
            Carregando, a tensão fica acima da de repouso: 3950 mV assentam em ~3,87 V,
            uns 60 %.

    config RLIGHT_BATERIA_CORTE_MV
        int "Corte seguro: abaixo desta tensão (mV) o terminal dorme"
        range 3300 3800
        default 3550
        help
            3550 mV ≈ 7 % numa INR18650-M29. O terminal mostra "carregue", dorme 10 min
            e mede de novo. O HW-465A não tem esse corte tão cedo.

    config RLIGHT_OLED_SH1106
        bool "OLED é SH1106 (1,3\"); desligado = SSD1306 (0,96\")"
        default y

    config RLIGHT_LED_GPIO
        int "GPIO do LED RGB da placa (-1 = sem LED)"
        default 48

    config RLIGHT_PALAVRA_LUMA
        bool "Palavra \"Ei, Luma\" (microWakeWord) em vez da WakeNet do ESP-SR"
        default n
        help
            Precisa do modelo treinado no Colab (palavra_luma/) copiado para
            main/palavra/ei_luma.tflite. Desliga a WakeNet (economiza CPU).

    config RLIGHT_LUMA_LIMIAR
        int "Limiar da média de probabilidade (0-255; 247 ≈ 0,97)"
        depends on RLIGHT_PALAVRA_LUMA
        range 1 255
        default 247

    config RLIGHT_LUMA_JANELA
        int "Janela da média (inferências)"
        depends on RLIGHT_PALAVRA_LUMA
        range 1 20
        default 5

    config RLIGHT_LUMA_ARENA
        int "Tensor arena do modelo (bytes, PSRAM)"
        depends on RLIGHT_PALAVRA_LUMA
        default 40000

endmenu
```
